
/ {
    servo: servo {
        compatible = "pwm-servo";
        pwms = <&pwm0 1 PWM_MSEC(20) PWM_POLARITY_NORMAL>;
        min-pulse = <PWM_USEC(1000)>;
        max-pulse = <PWM_USEC(2000)>;
    };
};
&pwm0_default {
    group1 {
        psels = <NRF_PSEL(PWM_OUT0, 0, 28)>, <NRF_PSEL(PWM_OUT1, 0, 4)>;
    };
};
